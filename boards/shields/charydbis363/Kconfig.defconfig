## boards/shields/charydbis363/Kconfig.defconfig
```kconfig
if SHIELD_CHARYBDIS363_RIGHT

config ZMK_KEYBOARD_NAME
	default "Charybdis363"

config ZMK_SPLIT_BLE_ROLE_CENTRAL
	default y

endif

if SHIELD_CHARYBDIS363_LEFT || SHIELD_CHARYBDIS363_RIGHT

config ZMK_SPLIT
	default y
	
endif
```

## boards/shields/charydbis363/Kconfig.shield
```kconfig
# Copyright (c) 2026 gcgbarbosa.com
# SPDX-License-Identifier: MIT

config SHIELD_CHARYBDIS363_LEFT
    def_bool $(shields_list_contains,charybdis363_left)

config SHIELD_CHARYBDIS363_RIGHT
    def_bool $(shields_list_contains,charybdis363_right)
```
